## Kconfig
```kconfig
# Electronya Embedded Services
# Copyright (C) 2025 by Electronya

config ENYA_EMBEDDED_SERVICES
  bool "Electronya Embedded Services"
  default y
  help
    The Electronya embedded services.
      - Service Manager
      - ADC Acquisition
      - Datastore
      - LED Strip

if ENYA_EMBEDDED_SERVICES

rsource "src/serviceCommon/Kconfig"
rsource "src/serviceManager/Kconfig"
rsource "src/adcAcquisition/Kconfig"
rsource "src/datastore/Kconfig"
rsource "src/ledStrip/Kconfig"
rsource "src/simhubDevice/Kconfig"

endif
```

## src/adcAcquisition/Kconfig
```kconfig
# Electronya ADC Acquisition Service
# Copyright (C) 2025 by Electronya

config ENYA_ADC_ACQUISITION
  bool "Electronya ADC Acquisition Service"
  default n
  depends on ADC
  help
    The Electronya ADC acquisition service.

    This service provides timer-triggered ADC acquisition with DMA,
    3rd-order cascaded RC filtering, and a publish-subscribe mechanism
    for ADC data. ADC channels and trigger timer are configured via
    devicetree.

if ENYA_ADC_ACQUISITION

config ENYA_ADC_ACQUISITION_LOG_LEVEL
  int "Electronya ADC Acquisition Log Level"
  default 3
  help
    The Electronya ADC acquisition log level.
    0=OFF, 1=ERR, 2=WRN, 3=INF, 4=DBG

config ENYA_ADC_ACQUISITION_STACK_SIZE
  int "Electronya ADC Acquisition Stack Size"
  default 512
  help
    The Electronya ADC acquisition service thread stack size in bytes.

config ENYA_ADC_ACQUISITION_SAMPLING_RATE_US
  int "Electronya ADC Acquisition Sampling Rate"
  default 500
  help
    The ADC sampling rate in microseconds. Used to set the trigger timer period.

config ENYA_ADC_ACQUISITION_FILTER_TAU
  int "Electronya ADC Acquisition Filter Tau"
  default 31
  range 1 511
  help
    The ADC 3rd-order cascaded RC filter tau value (alpha * 512).
    See AdcConfig_t documentation for calculation details.

config ENYA_ADC_ACQUISITION_MAX_SUB_COUNT
  int "Electronya ADC Acquisition Maximum Subscriber Count"
  default 4
  range 1 32
  help
    The maximum number of concurrent ADC data subscribers.

config ENYA_ADC_ACQUISITION_NOTIFICATION_RATE_MS
  int "Electronya ADC Acquisition Notification Rate"
  default 100
  help
    The rate at which subscribers are notified with new ADC data, in milliseconds.
    Also drives the service thread loop period.

config ENYA_ADC_ACQUISITION_THREAD_PRIORITY
  int "Electronya ADC Acquisition Thread Priority"
  default 5
  help
    The ADC acquisition service thread scheduling priority (preemptive).

config ENYA_ADC_ACQUISITION_SERVICE_PRIORITY
  int "Electronya ADC Acquisition Service Priority"
  default 1
  range 0 2
  help
    The ADC acquisition service priority level for the service manager.
    0 = CRITICAL, 1 = CORE, 2 = APPLICATION.

config ENYA_ADC_ACQUISITION_HEARTBEAT_INTERVAL_MS
  int "Electronya ADC Acquisition Heartbeat Interval"
  default 1000
  help
    The interval in milliseconds at which the ADC acquisition service
    updates its heartbeat with the service manager.

config ENYA_ADC_ACQUISITION_SHELL
  bool "Electronya ADC Acquisition Shell Commands"
  default y
  depends on SHELL
  help
    Enable shell commands for ADC acquisition service.
    Provides commands to get channel count, raw values, and voltage values.

    Commands:
      adc_acq get_chan_count - Get the number of ADC channels
      adc_acq get_raw <chan>  - Get raw ADC value for a channel
      adc_acq get_volt <chan> - Get voltage value for a channel

config ENYA_ADC_VREF_STABILIZATION_US
  int "Vref stabilization time (microseconds)"
  default 15 if SOC_FAMILY_STM32
  default 0
  help
    Time to wait after enabling VREFINT for it to stabilize.
    STM32 datasheets specify minimum 12μs, default 15μs for safety margin.
    Set to 0 to skip the wait (e.g. on non-STM32 targets or simulators).

endif
```

## src/datastore/Kconfig
```kconfig
# Electronya Embedded Datastore
# Copyright (C) 2025 by Electronya

config ENYA_DATASTORE
  bool "Electronya Embedded Datastore"
  default y
  depends on CMSIS_RTOS_V2
  help
    The Electronya embedded application datastore.

if ENYA_DATASTORE

config ENYA_DATASTORE_LOG_LEVEL
  int "Electronya Embedded Datastore Log Level"
  default 3
  help
    The Electronya embedded datastore log level.

config ENYA_DATASTORE_MSGQ_TIMEOUT
  int "Datastore Message Queue Get Timeout (ms)"
  default 100
  help
    The timeout for k_msgq_get in the datastore run loop in milliseconds.

config ENYA_DATASTORE_STACK_SIZE
  int "Electronya Datastore Stack Size"
  default 512
  help
    The Electronya datastore service thread stack size in bytes.

config ENYA_DATASTORE_BUFFER_SIZE
  int "Electronya Datastore Command Buffer Size"
  default 32
  help
    The maximum number of Data_t elements that can be read/written
    in a single shell command operation.

config ENYA_DATASTORE_SHELL
  bool "Electronya Datastore Shell Commands"
  default y
  depends on SHELL
  help
    Enable shell commands for the datastore service.
    Provides commands to list, read, and write datapoints for all types:
    binary, button, float, int, multi-state, and uint.

    Commands:
      datastore binary_data ls                    - List binary datapoints
      datastore binary_data read <id> [count]     - Read binary values
      datastore binary_data write <id> <count> <values...> - Write binary values
      (Similar commands available for button, float, int, multi-state, uint)

config ENYA_DATASTORE_MAX_BINARY_SUBS
  int "Electronya Datastore Maximum Binary Subscriptions"
  default 2
  help
    The maximum number of binary datapoint subscriptions.

config ENYA_DATASTORE_MAX_BUTTON_SUBS
  int "Electronya Datastore Maximum Button Subscriptions"
  default 2
  help
    The maximum number of button datapoint subscriptions.

config ENYA_DATASTORE_MAX_FLOAT_SUBS
  int "Electronya Datastore Maximum Float Subscriptions"
  default 2
  help
    The maximum number of float datapoint subscriptions.

config ENYA_DATASTORE_MAX_INT_SUBS
  int "Electronya Datastore Maximum Integer Subscriptions"
  default 2
  help
    The maximum number of signed integer datapoint subscriptions.

config ENYA_DATASTORE_MAX_MULTI_STATE_SUBS
  int "Electronya Datastore Maximum Multi-State Subscriptions"
  default 2
  help
    The maximum number of multi-state datapoint subscriptions.

config ENYA_DATASTORE_MAX_UINT_SUBS
  int "Electronya Datastore Maximum Unsigned Integer Subscriptions"
  default 2
  help
    The maximum number of unsigned integer datapoint subscriptions.

config ENYA_DATASTORE_THREAD_PRIORITY
  int "Electronya Datastore Thread Priority"
  default 5
  help
    The Zephyr preemptible thread priority for the datastore service thread.

config ENYA_DATASTORE_SERVICE_PRIORITY
  int "Electronya Datastore Service Priority"
  default 1
  help
    The service manager priority level for the datastore service.

config ENYA_DATASTORE_HEARTBEAT_INTERVAL_MS
  int "Electronya Datastore Heartbeat Interval (ms)"
  default 1000
  help
    The heartbeat interval in milliseconds for the datastore service.

config FIRST_FLOAT_DEFAULT_VAL
  int "First Float Default Value"
  default 123
  help
    The 1st float default value. Needs to be divided by 10.

config SECOND_INT_DEFAULT_VAL
  int "Second Signed Integer Default Value"
  default -12
  help
    The 2nd signed integer default value.

endif
```

## src/ledStrip/Kconfig
```kconfig
# Electronya LED Strip Service
# Copyright (C) 2026 by Electronya

config ENYA_LED_STRIP
  bool "Electronya LED Strip Service"
  default n
  depends on LED_STRIP && CMSIS_RTOS_V2
  help
    The Electronya LED strip service.

    Drives a single LED strip at a constant refresh rate via the Zephyr LED
    strip driver API. Supports RGB and RGBW strips through DTS color-mapping
    configuration. Channel ordering is the producer's responsibility.

    Requires a DTS alias "led-strip" bound to a compatible LED strip device.

if ENYA_LED_STRIP

config ENYA_LED_STRIP_LOG_LEVEL
  int "Electronya LED Strip Log Level"
  default 3
  help
    The Electronya LED strip service log level.
    0=OFF, 1=ERR, 2=WRN, 3=INF, 4=DBG

config ENYA_LED_STRIP_STACK_SIZE
  int "Electronya LED Strip Stack Size"
  default 1024
  help
    The LED strip service thread stack size in bytes.

config ENYA_LED_STRIP_THREAD_PRIORITY
  int "Electronya LED Strip Thread Priority"
  default 5
  help
    The LED strip service thread scheduling priority (preemptive).

config ENYA_LED_STRIP_SERVICE_PRIORITY
  int "Electronya LED Strip Service Priority"
  default 2
  range 0 2
  help
    The LED strip service priority level for the service manager.
    0 = CRITICAL, 1 = CORE, 2 = APPLICATION.

config ENYA_LED_STRIP_HEARTBEAT_INTERVAL_MS
  int "Electronya LED Strip Heartbeat Interval (ms)"
  default 1000
  help
    The interval in milliseconds at which the LED strip service updates
    its heartbeat with the service manager.


config ENYA_LED_STRIP_REFRESH_RATE_HZ
  int "Electronya LED Strip Refresh Rate (Hz)"
  default 60
  range 1 120
  help
    The rate at which the LED strip service pushes the current frame to
    hardware, regardless of producer frame rate.

config ENYA_LED_STRIP_MSG_COUNT
  int "Electronya LED Strip Message Queue Depth"
  default 4
  range 1 16
  help
    The depth of the LED strip service control message queue. This queue
    carries lightweight control messages (brightness, fill, frame submit
    notifications) — not pixel data. The pixel data pool always has
    exactly 2 blocks.

config ENYA_LED_STRIP_SHELL
  bool "Electronya LED Strip Shell Commands"
  default y
  depends on SHELL
  help
    Enable shell commands for the LED strip service.
    Provides commands to control brightness and fill the strip.

    Commands:
      led_strip brightness <0-255>              - Set global brightness
      led_strip fill <ch0> <ch1> <ch2>          - Fill all pixels (RGB)
      led_strip fill <ch0> <ch1> <ch2> <ch3>    - Fill all pixels (RGBW)
      led_strip off                             - Turn off all pixels

endif
```

## src/serviceCommon/Kconfig
```kconfig
# Electronya Embedded Services - Service Common
# Copyright (C) 2026 by Electronya

config ENYA_SERVICE_COMMON
  bool "Electronya Service Common Definitions"
  default y
  help
    Common data structures and definitions used across all services
    for inter-service communication. This module provides the
    SrvMsgPayload_t structure for passing data between services
    via message queues.

if ENYA_SERVICE_COMMON

config ENYA_USB_DEVICE
  bool "Electronya USB Device"
  depends on USB_DEVICE_STACK_NEXT
  select HWINFO
  help
    Shared USB device stack utility. Owns the USBD context, string
    descriptors, and FS configuration. All USB-capable services
    (e.g. simhubDevice, hidController) rely on this utility for
    USB initialization. Call usbDeviceInit() before any USB service
    init, and usbDeviceEnable() after all USB services are registered.

if ENYA_USB_DEVICE

config ENYA_USB_DEVICE_VID
  hex "USB Vendor ID"
  default 0x2FE3
  help
    USB Vendor ID reported in the device descriptor.

config ENYA_USB_DEVICE_PID
  hex "USB Product ID"
  default 0x0001
  help
    USB Product ID reported in the device descriptor.

config ENYA_USB_DEVICE_MANUFACTURER
  string "USB Manufacturer String"
  default "Electronya"
  help
    Manufacturer string descriptor.

config ENYA_USB_DEVICE_PRODUCT
  string "USB Product String"
  default "Electronya Device"
  help
    Product string descriptor.

config ENYA_USB_DEVICE_MAX_POWER
  int "USB Max Power (mA)"
  default 250
  range 0 500
  help
    Maximum current draw reported in the configuration descriptor (mA).

config ENYA_USB_DEVICE_LOG_LEVEL
  int "Electronya USB Device Log Level"
  default 3
  help
    Log level for the USB device utility.
    0=OFF, 1=ERR, 2=WRN, 3=INF, 4=DBG

endif # ENYA_USB_DEVICE

endif # ENYA_SERVICE_COMMON
```

## src/serviceManager/Kconfig
```kconfig
# Copyright (C) 2025 by Electronya
# SPDX-License-Identifier: Apache-2.0

menuconfig ENYA_SERVICE_MANAGER
	bool "Service Manager"
	default y
	select WATCHDOG
	help
	  Enable the service manager module. The service manager acts as a
	  virtual watchdog that controls hardware watchdog, starts registered
	  services in priority order, manages service state (start, stop,
	  suspend, resume), and monitors service health via heartbeats.

if ENYA_SERVICE_MANAGER

config ENYA_SERVICE_MANAGER_STACK_SIZE
	int "Service manager thread stack size"
	default 512
	help
	  Stack size for the service manager thread in bytes.

config ENYA_SERVICE_MANAGER_LOG_LEVEL
	int "Service manager log level"
	default 3
	range 0 4
	help
	  Log level for the service manager module.
	  0 = OFF, 1 = ERR, 2 = WRN, 3 = INF, 4 = DBG

config SVC_MGR_MAX_SERVICES
	int "Maximum number of services"
	default 16
	range 1 64
	help
	  Maximum number of services that can be registered with the
	  service manager.

config SVC_MGR_WDT_TIMEOUT_MS
	int "Hardware watchdog timeout in milliseconds"
	default 5000
	range 1000 60000
	help
	  Hardware watchdog timeout in milliseconds. The service manager
	  feeds the watchdog on every loop iteration. This timeout should
	  be significantly larger than the loop period.

config SVC_MGR_LOOP_PERIOD_MS
	int "Service manager loop period in milliseconds"
	default 100
	range 10 1000
	help
	  Period at which the service manager thread runs. The manager
	  checks heartbeats, processes state change requests, and feeds
	  the watchdog on every iteration.

config ENYA_SERVICE_MANAGER_THREAD_PRIORITY
	int "Service manager thread priority"
	default 1
	help
	  The Zephyr preemptible thread priority for the service manager thread.

config ENYA_SERVICE_MANAGER_SHELL
	bool "Enable service manager shell commands"
	default y
	depends on SHELL
	help
	  Enable shell commands for the service manager. This allows
	  querying service status and controlling services via the shell.

endif # ENYA_SERVICE_MANAGER
```

## src/simhubDevice/Kconfig
```kconfig
# Electronya SimHub Device Service
# Copyright (C) 2026 by Electronya
# SPDX-License-Identifier: Apache-2.0

config ENYA_SIMHUB_DEVICE
  bool "Electronya SimHub Device Service"
  default n
  depends on UART_ASYNC_API && ENYA_LED_STRIP
  help
    The Electronya SimHub Device service. Implements the SimHub Standard
    Arduino/Dash serial protocol over CDC ACM USB, receiving RGB frame data
    from SimHub and forwarding it to the LED strip service.

    Requires the simhub-uart DTS alias pointing to a zephyr,cdc-acm-uart node.

if ENYA_SIMHUB_DEVICE

config ENYA_SIMHUB_DEVICE_LOG_LEVEL
  int "Electronya SimHub Device Log Level"
  default 3
  help
    The Electronya SimHub device service log level.
    0=OFF, 1=ERR, 2=WRN, 3=INF, 4=DBG

config ENYA_SIMHUB_DEVICE_STACK_SIZE
  int "Electronya SimHub Device Stack Size"
  default 1024
  help
    The Electronya SimHub device service thread stack size in bytes.

config ENYA_SIMHUB_DEVICE_THREAD_PRIORITY
  int "Electronya SimHub Device Thread Priority"
  default 6
  help
    The SimHub device service thread scheduling priority (preemptive).

config ENYA_SIMHUB_DEVICE_SERVICE_PRIORITY
  int "Electronya SimHub Device Service Priority"
  default 2
  range 0 2
  help
    The SimHub device service priority level for the service manager.
    0 = CRITICAL, 1 = CORE, 2 = APPLICATION.

config ENYA_SIMHUB_DEVICE_HEARTBEAT_INTERVAL_MS
  int "Electronya SimHub Device Heartbeat Interval"
  default 1000
  help
    The interval in milliseconds at which the SimHub device service updates
    its heartbeat with the service manager.

config ENYA_SIMHUB_DEVICE_SHELL
  bool "Electronya SimHub Device Shell Commands"
  default y
  depends on SHELL
  help
    Enable shell commands for the SimHub device service.

    Commands:
      simhub status - Connection state, frames received, current frame rate
      simhub reset  - Force parser back to initial state
      simhub info   - Protocol version string and pixel count

endif
```
