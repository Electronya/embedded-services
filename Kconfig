## tests/adcAcquisition/cmd/testcase.yaml
```yaml
tests:
  electronya.embedded_services.adc_acquisition.cmd:
    tags:
      - unit_test
      - adc
    platform_allow:
      - native_sim
      - native_sim/native/64
```

## tests/adcAcquisition/util/testcase.yaml
```yaml
tests:
  electronya.embedded_services.adc_acquisition.util:
    tags:
      - unit_test
      - adc
    platform_allow:
      - native_sim
      - native_sim/native/64
```

## tests/datastore/cmd/testcase.yaml
```yaml
tests:
  electronya.embedded_datastore.datastore.cmd:
    tags:
      - unit_test
      - datastore
    platform_allow:
      - native_sim
      - native_sim/native/64
```

## tests/datastore/cmdUtil/testcase.yaml
```yaml
tests:
  electronya.embedded_services.datastore.cmdUtil:
    tags:
      - unit_test
      - datastore
    platform_allow:
      - native_sim
      - native_sim/native/64
```

## tests/datastore/ds/testcase.yaml
```yaml
tests:
  electronya.embedded_datastore.datastore.ds:
    tags:
      - unit
      - datastore
    platform_allow:
      - native_sim
```

## tests/datastore/service/Kconfig
```kconfig
# Copyright (C) 2025 by Electronya
# SPDX-License-Identifier: Apache-2.0

config ENYA_DATASTORE_MSGQ_TIMEOUT
	int "Datastore message queue timeout in milliseconds"
	default 1
	help
	  Timeout for k_msgq_get operations in the datastore service.
	  Set to 0 for immediate return (K_NO_WAIT behavior).
	  Set to >0 for timeout in milliseconds.

source "Kconfig.zephyr"
```

## tests/datastore/service/testcase.yaml
```yaml
tests:
  electronya.embedded_datastore.datastore.service:
    tags:
      - unit
      - datastore
    platform_allow:
      - native_sim
  electronya.embedded_datastore.datastore.service.timeout_zero:
    tags:
      - unit
      - datastore
    platform_allow:
      - native_sim
    extra_configs:
      - CONFIG_ENYA_DATASTORE_MSGQ_TIMEOUT=0
```

## tests/datastore/util/testcase.yaml
```yaml
tests:
  electronya.embedded_services.datastore.util:
    tags:
      - unit_test
      - datastore
    platform_allow:
      - native_sim
      - native_sim/native/64
```

## tests/ledStrip/cmd/testcase.yaml
```yaml
tests:
  electronya.embedded_services.led_strip.cmd:
    tags:
      - unit_test
      - led_strip
    platform_allow:
      - native_sim
      - native_sim/native/64
```

## tests/ledStrip/service/testcase.yaml
```yaml
tests:
  electronya.embedded_services.led_strip.service:
    tags:
      - unit_test
      - led_strip
    platform_allow:
      - native_sim
      - native_sim/native/64
```

## tests/serviceCommon/usbDevice/testcase.yaml
```yaml
tests:
  electronya.embedded_services.service_common.usb_device:
    tags:
      - unit_test
      - service_common
    platform_allow:
      - native_sim
      - native_sim/native/64
```

## tests/serviceCommon/usbDeviceNoIad/testcase.yaml
```yaml
tests:
  electronya.embedded_services.service_common.usb_device_no_iad:
    tags:
      - unit_test
      - service_common
    platform_allow:
      - native_sim
      - native_sim/native/64
```

## tests/serviceManager/service/testcase.yaml
```yaml
tests:
  electronya.embedded_services.service_manager.service:
    tags:
      - unit_test
      - service_manager
    platform_allow:
      - native_sim
      - native_sim/native/64
```

## tests/serviceManager/util/testcase.yaml
```yaml
tests:
  electronya.embedded_services.service_manager.util:
    tags:
      - unit_test
      - service_manager
    platform_allow:
      - native_sim
      - native_sim/native/64
```

## tests/simhubDevice/proto/testcase.yaml
```yaml
tests:
  electronya.embedded_services.simhub_device.proto:
    tags:
      - unit_test
      - simhub
    platform_allow:
      - native_sim
      - native_sim/native/64
```

## tests/simhubDevice/util/testcase.yaml
```yaml
tests:
  electronya.embedded_services.simhub_device.util:
    tags:
      - unit_test
      - simhub
    platform_allow:
      - native_sim
      - native_sim/native/64
```
